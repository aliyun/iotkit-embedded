## external_libs/at/Config.in
```kconfig
config ATPARSER_ENABLED
    bool "FEATURE_ATPARSER_ENABLED"
    default n

choice
    prompt "SAL HAL Configurations"
    depends on ATPARSER_ENABLED
    default SAL_HAL_IMPL_NONE

config SAL_HAL_IMPL_NONE
        bool "FEATURE_SAL_HAL_IMPL_NONE"
        default n

config SAL_HAL_IMPL_MK3060
        bool "FEATURE_SAL_HAL_IMPL_MK3060"
        default n

config SAL_HAL_IMPL_SIM800
        bool "FEATURE_SAL_HAL_IMPL_SIM800"
        default n
endchoice
```

## src/alink/Config.in
```kconfig
config ALINK_PROTOCOL_ENABLE
    bool "ALINK_PROTOCOL_ENABLE"
    default n
    select DEV_SIGN
```

## src/dev_model/Config.in
```kconfig
config DEVICE_MODEL_ENABLE
    bool "FEATURE_DEVICE_MODEL_ENABLED"
    default n
    select DEV_SIGN
    select INFRA_CJSON
    help
        Enable providing Thing-Model-Management/Alink-Protocol encapulation in SDK

        Switching to "y" leads to SDK being able to interpret JSON payload in MQTT channel, which also called "Advanced Version Protocol"
        Those capabilities are provided via IOT_Linkkit_XXX() APIs

config DEVICE_MODEL_GATEWAY
    bool "FEATURE_DEVICE_MODEL_GATEWAY"
    depends on DEVICE_MODEL_ENABLE
    default n
    select INFRA_STRING
    select INFRA_SHA256
    select INFRA_LIST
    select THREAD_COST_INTERNAL
    help
        Switching Thing-Model related implementations provided in gateway oriented way

config THREAD_COST_INTERNAL
    bool "FEATURE_THREAD_COST_INTERNAL"
    depends on DEVICE_MODEL_ENABLE
    default n
    help
        Create thread in device model internal, and some subdev opertion API will become sync interface(e.g. using IOT_Linkkit_Connect() to register subdevice and
        using IOT_Linkkit_Report() to login or logout sudevice.
```

## src/dev_sign/Config.in
```kconfig
config DEV_SIGN
    bool
    default y
    select ALGO_SHA256_WRAPPER
    select INFRA_STRING
```

## src/device_model/Config.in
```kconfig
config ALINK_PROTOCOL_ENABLE
    bool "ALINK_PROTOCOL_ENABLE"
    default n
    select DEV_SIGN

config ALINK_PROTOCOL_RAW_DATA
    bool "ALINK_PROTOCOL_RAW_DATA"
    default n
    depends on ALINK_PROTOCOL_ENABLE
```

## src/dynreg/Config.in
```kconfig
config DYNAMIC_REGISTER
    bool "FEATURE_DYNAMIC_REGISTER"
    default n
    select ALGO_SHA256_WRAPPER
    select INFRA_STRING
    select INFRA_RANDOM
    select INFRA_HTTPC
```

## src/infra/Config.in
```kconfig
config PLATFORM_HAS_STDINT
    bool "PLATFORM_HAS_STDINT"
    default y

config INFRA_STRING
    bool
    default n

config INFRA_NET
    bool
    default n

config INFRA_LOG
    bool
    default n

config INFRA_MEM_STATS
    bool
    default n

config INFRA_TIMER
    bool
    default n

config INFRA_RANDOM
    bool
    default n

config INFRA_CJSON
    bool
    default n

config INFRA_SHA256
    bool
    default n

config INFRA_HTTPC
    bool
    default n
    select INFRA_NET
    select INFRA_TIMER
```

## src/mqtt/Config.in
```kconfig
config MQTT_COMM_ENABLED
    bool "FEATURE_MQTT_COMM_ENABLED"
    default y
    select DEV_SIGN
    select INFRA_SHA256
    select INFRA_NET
    select INFRA_LIST
    select INFRA_TIMER
    select INFRA_REPORT
    select HAL_TCP

    help
        Establish persistent connection with AliCloud via MQTT-based protocol

        Switching to "y" leads to building MQTT related implementation into SDK and MQTT_COMM_ENABLED included into CFLAGS
        Switching to "n" seldom happens unless you're connecting to AliCloud via CoAP/HTTP channel

config MQTT_DEFAULT_IMPL
    bool "FEATURE_MQTT_DEFAULT_IMPL"
    default y

    depends on MQTT_COMM_ENABLED
    select INFRA_SHA256
    select INFRA_NET
    select INFRA_TIMER
    select HAL_TCP

    help
        Use SDK default MQTT implementation

        Switching to "y" leads to building MQTT related implementation into SDK and MQTT_DEFAULT_IMPL included into CFLAGS
        Switching to "n" seldom happens unless you're using other MQTT implementations


source "wrappers/mqtt/mal/Config.in"

# menu "MQTT Configurations"
#     depends on MQTT_COMM_ENABLED
# 
#     config MQTT_LOGPOST
#         bool "FEATURE_MQTT_LOGPOST"
#         default n
#         help
#             Enable capability of publishing important device running log messages to IoT cloud
# 
# endmenu
```

## src/ota/Config.in
```kconfig
config OTA_ENABLED
    bool "FEATURE_OTA_ENABLED"
    default n
    select INFRA_STRING
    select INFRA_JSON_PARSER
    select INFRA_HTTPC
    select INFRA_MD5
    select INFRA_SHA256
    select MQTT_COMM_ENABLED
```

## src/sal/Config.in
```kconfig
config SAL_ENABLED
    bool "FEATURE_SAL_ENABLED"
    default n


menu "SAL Configurations"
    depends on SAL_ENABLED

choice
    prompt "SAL HAL Configurations"
    depends on ATPARSER_ENABLED
    default SAL_HAL_IMPL_NONE

config SAL_HAL_IMPL_NONE
        bool "FEATURE_SAL_HAL_IMPL_NONE"
        default n

config SAL_HAL_IMPL_MK3060
        bool "FEATURE_SAL_HAL_IMPL_MK3060"
        default n

config SAL_HAL_IMPL_SIM800
        bool "FEATURE_SAL_HAL_IMPL_SIM800"
        default n
endchoice

config SOCKET_SELECT_ENABLED
    bool "FEATURE_SOCKET_SELECT_ENABLED"
    default n

endmenu
```

## tools/Config.in
```kconfig
mainmenu "Main Menu"
comment "Configure C-SDK for IoT Embedded Devices"

source "tools/menu/Config.infra"
source "tools/menu/Config.dev_sign"
source "tools/menu/Config.mqtt"
source "tools/menu/Config.dynamic_register"
source "tools/menu/Config.dev_model"
source "tools/menu/Config.wrappers"
source "tools/menu/Config.atm"
source "tools/menu/Config.ota"
```

## tools/menu/infra/Config.in
```kconfig
config PLATFORM_HAS_STDINT
    bool "PLATFORM_HAS_STDINT"
    default y

config PLATFORM_HAS_DYNMEM
        bool "PLATFORM_HAS_DYNMEM"
        default y

config PLATFORM_HAS_OS
        bool "PLATFORM_HAS_OS"
        default n

config INFRA_STRING
    bool
    default n

config INFRA_NET
    bool
    default n

config INFRA_LIST
    bool
    default n

config INFRA_LOG
    bool
    default n

config INFRA_MEM_STATS
    bool
    default n

config INFRA_TIMER
    bool
    default n

config INFRA_RANDOM
    bool
    default n

config INFRA_JSON_PARSER
    bool
    default n

config INFRA_CJSON
    bool
    default n

config INFRA_MD5
    bool
    default n

config INFRA_SHA1
    bool
    default n

config INFRA_SHA256
    bool
    default n

config INFRA_REPORT
    bool
    default n
    select INFRA_STRING

config INFRA_HTTPC
    bool
    default n
    select INFRA_NET
    select INFRA_TIMER

config INFRA_MEM_STATS
    bool
    default n
    select INFRA_LIST

config INFRA_PRE_AUTH
    bool
    default n

config INFRA_COMPAT
    bool
    default n
```

## tools/menu/mqtt/Config.in
```kconfig
config MQTT_COMM_ENABLED
    bool "FEATURE_MQTT_COMM_ENABLED"
    default y
    select DEV_SIGN
    select INFRA_PRE_AUTH if !MQTT_DIRECT
    select INFRA_SHA256
    select INFRA_LIST
    select INFRA_TIMER
    select INFRA_REPORT
    select INFRA_COMPAT

    help
        Establish persistent connection with AliCloud via MQTT-based protocol

        Switching to "y" leads to building MQTT related implementation into SDK and MQTT_COMM_ENABLED included into CFLAGS
        Switching to "n" seldom happens unless you're connecting to AliCloud via CoAP/HTTP channel

menu "MQTT Configurations"
    depends on MQTT_COMM_ENABLED

    config MQTT_DEFAULT_IMPL
        bool "FEATURE_MQTT_DEFAULT_IMPL"
        default y

        select INFRA_SHA256
        select INFRA_NET
        select INFRA_TIMER

        help
            Use SDK default MQTT implementation

            Switching to "y" leads to building MQTT related implementation into SDK and MQTT_DEFAULT_IMPL included into CFLAGS
            Switching to "n" seldom happens unless you're using other MQTT implementations

    choice
        prompt "MQTT Connection Mode"
        default MQTT_DIRECT

    config MQTT_PRE_AUTH
        bool "FEATURE_MQTT_PRE_AUTH"
        default n
        select SUPPORT_TLS
        select INFRA_HTTPC

        help
            Connect HTTPS server to Pre-authenticate

            Switching to "y" leads to legacy authenticate mode: connnect HTTP server first, then connect MQTT server afterwards

    config MQTT_DIRECT
        bool "FEATURE_MQTT_DIRECT"
        default n

        help
            Directly connect MQTT server without perform HTTP authenticate to another HTTP server ahead

            Switching to "y" leads to connect MQTT server directly and MQTT_DIRECT included into CFLAGS

    endchoice

    config ASYNC_PROTOCOL_STACK
        bool "FEATURE_ASYNC_PROTOCOL_STACK"
        default n

        help
            Use async protocol stack for SDK default MQTT implementation

            Switching to "y" leads to building MQTT async protocol stack related implementation into SDK and ASYNC_PROTOCOL_STACK included into CFLAGS
            Switching to "n" seldom happens unless you're not using async protocol stack

endmenu
```

## tools/menu/wrappers/Config.in
```kconfig
config ALGO_SHA256_WRAPPER
    bool
    default n

config HAL_KV
    bool
    default n

config SUPPORT_TLS
    bool "FEATURE_SUPPORT_TLS"
    default n
```

## wrappers/Config.in
```kconfig
config ALGO_SHA256_WRAPPER
    bool
    default n

config HAL_KV
    bool
    default n

choice
    prompt "Security Option"
    default SUPPORT_TCP

    config SUPPORT_TCP
        bool "FEATURE_SUPPORT_TCP"

    config SUPPORT_TLS
        bool "FEATURE_SUPPORT_TLS"
        help
            This option is mutually exclusive with SUPPORT_ITLS, only less than one of them can be switched to "y"

    config SUPPORT_ITLS
        bool "FEATURE_SUPPORT_ITLS"
        help
            This option is mutually exclusive with SUPPORT_TLS, only less than one of them can be switched to "y"

            iTLS is a TLS implementation based on ID2, and ID2 service is professional security solution based on special hardware

endchoice
```

## wrappers/mqtt/mal/Config.in
```kconfig
config MAL_ENABLED
    bool "FEATURE_MAL_ENABLED"

    depends on MQTT_COMM_ENABLED
    depends on !MQTT_DEFAULT_IMPL
    default n

    help
        Establish persistent connection with AliCloud via MAL(MQTT Adapter Layer).

        Switch to "y" leads to building MAL into SDK and MAL_ENABLED included into CFLAGS.
        Switch to "n" leads to not use MAL method to establish persistent connection with AliCloud.

menu "MAL Configurations"
    depends on MAL_ENABLED

    config MAL_ICA_ENABLED
        bool "FEATURE_MAL_ICA_ENABLED"
        default n
        help
            USE ICA AT method

            Switching to "y" leads to use ICA at method.
            Switching to "n" leads to not use ICA at method.

endmenu
```

## wrappers/sal/Config.in
```kconfig
config SAL_ENABLED
    bool "FEATURE_SAL_ENABLED"
    default n

choice
    prompt "SAL Configurations"
    depends on SAL_ENABLED
    default SAL_HAL_IMPL_MK3060

config SAL_HAL_IMPL_MK3060
        bool "FEATURE_SAL_HAL_IMPL_MK3060"
        default n

config SAL_HAL_IMPL_SIM800
        bool "FEATURE_SAL_HAL_IMPL_SIM800"
        default n
endchoice

config MULTI_TASK_MODE
    bool "FEATURE_MULTI_TASK_MODE"
    depends on SAL_ENABLED
    default y
```
